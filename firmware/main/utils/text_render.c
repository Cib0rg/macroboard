/**
 * @file text_render.c
 * @brief Text rendering to GC9D01 displays (160x160 RGB565)
 */

#include "text_render.h"
#include "hardware/gc9a01.h"
#include "config.h"
#include <string.h>
#include <stddef.h>
#include "esp_heap_caps.h"
#include "esp_log.h"

static const char* TAG = "TEXT";

// ============================================================
// 8x8 bitmap font — printable ASCII 0x20..0x7E (95 glyphs)
// Each glyph: 8 bytes, one per row top-to-bottom.
// Each byte: MSB = leftmost pixel.
// ============================================================

#define FONT_W           8
#define FONT_H           8
#define FONT_FIRST       0x20
#define FONT_LAST        0x7E
#define FONT_GLYPHS      (FONT_LAST - FONT_FIRST + 1)  // 95

static const uint8_t font8x8[FONT_GLYPHS][FONT_H] = {
    /* 0x20  ' '  */ {0x00, 0x00, 0x00, 0x00, 0x00, 0x00, 0x00, 0x00},
    /* 0x21  '!'  */ {0x18, 0x3C, 0x3C, 0x18, 0x18, 0x00, 0x18, 0x00},
    /* 0x22  '"'  */ {0x36, 0x36, 0x12, 0x00, 0x00, 0x00, 0x00, 0x00},
    /* 0x23  '#'  */ {0x36, 0x36, 0x7F, 0x36, 0x7F, 0x36, 0x36, 0x00},
    /* 0x24  '$'  */ {0x0C, 0x3E, 0x03, 0x1E, 0x30, 0x1F, 0x0C, 0x00},
    /* 0x25  '%'  */ {0x00, 0x63, 0x33, 0x18, 0x0C, 0x66, 0x63, 0x00},
    /* 0x26  '&'  */ {0x1C, 0x36, 0x1C, 0x6E, 0x3B, 0x33, 0x6E, 0x00},
    /* 0x27  '\'' */ {0x06, 0x06, 0x03, 0x00, 0x00, 0x00, 0x00, 0x00},
    /* 0x28  '('  */ {0x18, 0x0C, 0x06, 0x06, 0x06, 0x0C, 0x18, 0x00},
    /* 0x29  ')'  */ {0x06, 0x0C, 0x18, 0x18, 0x18, 0x0C, 0x06, 0x00},
    /* 0x2A  '*'  */ {0x00, 0x66, 0x3C, 0xFF, 0x3C, 0x66, 0x00, 0x00},
    /* 0x2B  '+'  */ {0x00, 0x0C, 0x0C, 0x3F, 0x0C, 0x0C, 0x00, 0x00},
    /* 0x2C  ','  */ {0x00, 0x00, 0x00, 0x00, 0x00, 0x0C, 0x0C, 0x06},
    /* 0x2D  '-'  */ {0x00, 0x00, 0x00, 0x3F, 0x00, 0x00, 0x00, 0x00},
    /* 0x2E  '.'  */ {0x00, 0x00, 0x00, 0x00, 0x00, 0x0C, 0x0C, 0x00},
    /* 0x2F  '/'  */ {0x60, 0x30, 0x18, 0x0C, 0x06, 0x03, 0x01, 0x00},
    /* 0x30  '0'  */ {0x1E, 0x33, 0x37, 0x3F, 0x3B, 0x33, 0x1E, 0x00},
    /* 0x31  '1'  */ {0x0C, 0x0E, 0x0C, 0x0C, 0x0C, 0x0C, 0x3F, 0x00},
    /* 0x32  '2'  */ {0x1E, 0x33, 0x30, 0x18, 0x0C, 0x03, 0x3F, 0x00},
    /* 0x33  '3'  */ {0x1E, 0x33, 0x30, 0x1C, 0x30, 0x33, 0x1E, 0x00},
    /* 0x34  '4'  */ {0x38, 0x3C, 0x36, 0x33, 0x7F, 0x30, 0x30, 0x00},
    /* 0x35  '5'  */ {0x3F, 0x03, 0x1F, 0x30, 0x30, 0x33, 0x1E, 0x00},
    /* 0x36  '6'  */ {0x1C, 0x06, 0x03, 0x1F, 0x33, 0x33, 0x1E, 0x00},
    /* 0x37  '7'  */ {0x3F, 0x33, 0x30, 0x18, 0x0C, 0x0C, 0x0C, 0x00},
    /* 0x38  '8'  */ {0x1E, 0x33, 0x33, 0x1E, 0x33, 0x33, 0x1E, 0x00},
    /* 0x39  '9'  */ {0x1E, 0x33, 0x33, 0x3E, 0x30, 0x18, 0x0E, 0x00},
    /* 0x3A  ':'  */ {0x00, 0x0C, 0x0C, 0x00, 0x00, 0x0C, 0x0C, 0x00},
    /* 0x3B  ';'  */ {0x00, 0x0C, 0x0C, 0x00, 0x00, 0x0C, 0x0C, 0x06},
    /* 0x3C  '<'  */ {0x18, 0x0C, 0x06, 0x03, 0x06, 0x0C, 0x18, 0x00},
    /* 0x3D  '='  */ {0x00, 0x00, 0x3F, 0x00, 0x00, 0x3F, 0x00, 0x00},
    /* 0x3E  '>'  */ {0x06, 0x0C, 0x18, 0x30, 0x18, 0x0C, 0x06, 0x00},
    /* 0x3F  '?'  */ {0x1E, 0x33, 0x30, 0x18, 0x0C, 0x00, 0x0C, 0x00},
    /* 0x40  '@'  */ {0x3E, 0x63, 0x7B, 0x7B, 0x7B, 0x03, 0x1E, 0x00},
    /* 0x41  'A'  */ {0x0C, 0x1E, 0x33, 0x33, 0x3F, 0x33, 0x33, 0x00},
    /* 0x42  'B'  */ {0x3F, 0x66, 0x66, 0x3E, 0x66, 0x66, 0x3F, 0x00},
    /* 0x43  'C'  */ {0x3C, 0x66, 0x03, 0x03, 0x03, 0x66, 0x3C, 0x00},
    /* 0x44  'D'  */ {0x1F, 0x36, 0x66, 0x66, 0x66, 0x36, 0x1F, 0x00},
    /* 0x45  'E'  */ {0x7F, 0x46, 0x16, 0x1E, 0x16, 0x46, 0x7F, 0x00},
    /* 0x46  'F'  */ {0x7F, 0x46, 0x16, 0x1E, 0x16, 0x06, 0x0F, 0x00},
    /* 0x47  'G'  */ {0x3C, 0x66, 0x03, 0x03, 0x73, 0x66, 0x7C, 0x00},
    /* 0x48  'H'  */ {0x33, 0x33, 0x33, 0x3F, 0x33, 0x33, 0x33, 0x00},
    /* 0x49  'I'  */ {0x1E, 0x0C, 0x0C, 0x0C, 0x0C, 0x0C, 0x1E, 0x00},
    /* 0x4A  'J'  */ {0x78, 0x30, 0x30, 0x30, 0x33, 0x33, 0x1E, 0x00},
    /* 0x4B  'K'  */ {0x67, 0x66, 0x36, 0x1E, 0x36, 0x66, 0x67, 0x00},
    /* 0x4C  'L'  */ {0x0F, 0x06, 0x06, 0x06, 0x46, 0x66, 0x7F, 0x00},
    /* 0x4D  'M'  */ {0x63, 0x77, 0x7F, 0x7F, 0x6B, 0x63, 0x63, 0x00},
    /* 0x4E  'N'  */ {0x63, 0x67, 0x6F, 0x7B, 0x73, 0x63, 0x63, 0x00},
    /* 0x4F  'O'  */ {0x1C, 0x36, 0x63, 0x63, 0x63, 0x36, 0x1C, 0x00},
    /* 0x50  'P'  */ {0x3F, 0x66, 0x66, 0x3E, 0x06, 0x06, 0x0F, 0x00},
    /* 0x51  'Q'  */ {0x1E, 0x33, 0x33, 0x33, 0x3B, 0x1E, 0x38, 0x00},
    /* 0x52  'R'  */ {0x3F, 0x66, 0x66, 0x3E, 0x36, 0x66, 0x67, 0x00},
    /* 0x53  'S'  */ {0x1E, 0x33, 0x07, 0x0E, 0x38, 0x33, 0x1E, 0x00},
    /* 0x54  'T'  */ {0x3F, 0x2D, 0x0C, 0x0C, 0x0C, 0x0C, 0x1E, 0x00},
    /* 0x55  'U'  */ {0x33, 0x33, 0x33, 0x33, 0x33, 0x33, 0x3F, 0x00},
    /* 0x56  'V'  */ {0x33, 0x33, 0x33, 0x33, 0x33, 0x1E, 0x0C, 0x00},
    /* 0x57  'W'  */ {0x63, 0x63, 0x63, 0x6B, 0x7F, 0x77, 0x63, 0x00},
    /* 0x58  'X'  */ {0x63, 0x63, 0x36, 0x1C, 0x1C, 0x36, 0x63, 0x00},
    /* 0x59  'Y'  */ {0x33, 0x33, 0x33, 0x1E, 0x0C, 0x0C, 0x1E, 0x00},
    /* 0x5A  'Z'  */ {0x7F, 0x63, 0x31, 0x18, 0x4C, 0x66, 0x7F, 0x00},
    /* 0x5B  '['  */ {0x1E, 0x06, 0x06, 0x06, 0x06, 0x06, 0x1E, 0x00},
    /* 0x5C  '\\' */ {0x03, 0x06, 0x0C, 0x18, 0x30, 0x60, 0x40, 0x00},
    /* 0x5D  ']'  */ {0x1E, 0x18, 0x18, 0x18, 0x18, 0x18, 0x1E, 0x00},
    /* 0x5E  '^'  */ {0x08, 0x1C, 0x36, 0x63, 0x00, 0x00, 0x00, 0x00},
    /* 0x5F  '_'  */ {0x00, 0x00, 0x00, 0x00, 0x00, 0x00, 0x00, 0xFF},
    /* 0x60  '`'  */ {0x0C, 0x0C, 0x18, 0x00, 0x00, 0x00, 0x00, 0x00},
    /* 0x61  'a'  */ {0x00, 0x00, 0x1E, 0x30, 0x3E, 0x33, 0x6E, 0x00},
    /* 0x62  'b'  */ {0x07, 0x06, 0x06, 0x3E, 0x66, 0x66, 0x3B, 0x00},
    /* 0x63  'c'  */ {0x00, 0x00, 0x1E, 0x33, 0x03, 0x33, 0x1E, 0x00},
    /* 0x64  'd'  */ {0x38, 0x30, 0x30, 0x3E, 0x33, 0x33, 0x6E, 0x00},
    /* 0x65  'e'  */ {0x00, 0x00, 0x1E, 0x33, 0x3F, 0x03, 0x1E, 0x00},
    /* 0x66  'f'  */ {0x1C, 0x36, 0x06, 0x0F, 0x06, 0x06, 0x0F, 0x00},
    /* 0x67  'g'  */ {0x00, 0x00, 0x6E, 0x33, 0x33, 0x3E, 0x30, 0x1F},
    /* 0x68  'h'  */ {0x07, 0x06, 0x36, 0x6E, 0x66, 0x66, 0x67, 0x00},
    /* 0x69  'i'  */ {0x0C, 0x00, 0x0E, 0x0C, 0x0C, 0x0C, 0x1E, 0x00},
    /* 0x6A  'j'  */ {0x30, 0x00, 0x30, 0x30, 0x30, 0x33, 0x33, 0x1E},
    /* 0x6B  'k'  */ {0x07, 0x06, 0x66, 0x36, 0x1E, 0x36, 0x67, 0x00},
    /* 0x6C  'l'  */ {0x0E, 0x0C, 0x0C, 0x0C, 0x0C, 0x0C, 0x1E, 0x00},
    /* 0x6D  'm'  */ {0x00, 0x00, 0x33, 0x7F, 0x7F, 0x6B, 0x63, 0x00},
    /* 0x6E  'n'  */ {0x00, 0x00, 0x1F, 0x33, 0x33, 0x33, 0x33, 0x00},
    /* 0x6F  'o'  */ {0x00, 0x00, 0x1E, 0x33, 0x33, 0x33, 0x1E, 0x00},
    /* 0x70  'p'  */ {0x00, 0x00, 0x3B, 0x66, 0x66, 0x3E, 0x06, 0x0F},
    /* 0x71  'q'  */ {0x00, 0x00, 0x6E, 0x33, 0x33, 0x3E, 0x30, 0x78},
    /* 0x72  'r'  */ {0x00, 0x00, 0x3B, 0x6E, 0x66, 0x06, 0x0F, 0x00},
    /* 0x73  's'  */ {0x00, 0x00, 0x3E, 0x03, 0x1E, 0x30, 0x1F, 0x00},
    /* 0x74  't'  */ {0x08, 0x0C, 0x3E, 0x0C, 0x0C, 0x2C, 0x18, 0x00},
    /* 0x75  'u'  */ {0x00, 0x00, 0x33, 0x33, 0x33, 0x33, 0x6E, 0x00},
    /* 0x76  'v'  */ {0x00, 0x00, 0x33, 0x33, 0x33, 0x1E, 0x0C, 0x00},
    /* 0x77  'w'  */ {0x00, 0x00, 0x63, 0x6B, 0x7F, 0x7F, 0x36, 0x00},
    /* 0x78  'x'  */ {0x00, 0x00, 0x63, 0x36, 0x1C, 0x36, 0x63, 0x00},
    /* 0x79  'y'  */ {0x00, 0x00, 0x33, 0x33, 0x33, 0x3E, 0x30, 0x1F},
    /* 0x7A  'z'  */ {0x00, 0x00, 0x3F, 0x19, 0x0C, 0x26, 0x3F, 0x00},
    /* 0x7B  '{'  */ {0x38, 0x0C, 0x0C, 0x07, 0x0C, 0x0C, 0x38, 0x00},
    /* 0x7C  '|'  */ {0x18, 0x18, 0x18, 0x00, 0x18, 0x18, 0x18, 0x00},
    /* 0x7D  '}'  */ {0x07, 0x0C, 0x0C, 0x38, 0x0C, 0x0C, 0x07, 0x00},
    /* 0x7E  '~'  */ {0x6E, 0x3B, 0x00, 0x00, 0x00, 0x00, 0x00, 0x00},
};

// ============================================================
// Internal helpers
// ============================================================

// Write one RGB565 pixel into an arbitrary-stride buffer (big-endian, for SPI)
static inline void put_pixel(uint8_t* buf, int x, int y, int stride, uint16_t color) {
    int idx = (y * stride + x) * 2;
    buf[idx]     = color >> 8;
    buf[idx + 1] = color & 0xFF;
}

// Draw one character into a buffer with explicit dimensions
static void draw_char_scaled(uint8_t* buf, int x, int y, char c, int scale,
                              uint16_t fg, uint16_t bg, int buf_w, int buf_h) {
    if (c < FONT_FIRST || c > FONT_LAST) c = '?';
    const uint8_t* glyph = font8x8[(uint8_t)c - FONT_FIRST];

    for (int row = 0; row < FONT_H; row++) {
        uint8_t bits = glyph[row];
        for (int col = 0; col < FONT_W; col++) {
            uint16_t color = (bits & (0x80 >> col)) ? fg : bg;
            for (int sy = 0; sy < scale; sy++) {
                int py = y + row * scale + sy;
                if (py < 0 || py >= buf_h) continue;
                for (int sx = 0; sx < scale; sx++) {
                    int px = x + (FONT_W - 1 - col) * scale + sx;
                    if (px < 0 || px >= buf_w) continue;
                    put_pixel(buf, px, py, buf_w, color);
                }
            }
        }
    }
}

// Split text into lines. Returns number of lines.
// Lines are split on '\n' and word-wrapped at chars_per_line.
// out_lines[i] must be at least (chars_per_line + 1) bytes wide.
#define MAX_LINES 20

static int split_lines(const char* text, int cpl,
                        char out_lines[MAX_LINES][21], int max_lines) {
    int n = 0;       // line index
    int pos = 0;     // position in current line

    out_lines[0][0] = '\0';

    const char* p = text;
    while (*p && n < max_lines) {
        if (*p == '\n') {
            out_lines[n][pos] = '\0';
            n++;
            if (n < max_lines) {
                pos = 0;
                out_lines[n][0] = '\0';
            }
            p++;
            continue;
        }

        // Find end of current word
        const char* word = p;
        while (*p && *p != ' ' && *p != '\n') p++;
        int wlen = (int)(p - word);

        // Skip trailing space
        if (*p == ' ') p++;

        if (wlen == 0) continue;

        if (pos == 0) {
            // Start of line: copy as much of the word as fits
            int copy = (wlen <= cpl) ? wlen : cpl;
            memcpy(out_lines[n] + pos, word, copy);
            pos += copy;
            out_lines[n][pos] = '\0';
        } else if (pos + 1 + wlen <= cpl) {
            // Word fits on current line with a space
            out_lines[n][pos++] = ' ';
            memcpy(out_lines[n] + pos, word, wlen);
            pos += wlen;
            out_lines[n][pos] = '\0';
        } else {
            // Start a new line
            out_lines[n][pos] = '\0';
            n++;
            if (n >= max_lines) break;
            pos = 0;
            int copy = (wlen <= cpl) ? wlen : cpl;
            memcpy(out_lines[n] + pos, word, copy);
            pos += copy;
            out_lines[n][pos] = '\0';
        }
    }

    if (pos > 0 && n < max_lines) {
        out_lines[n][pos] = '\0';
        n++;
    }

    return n;
}

// Render text centered in a buf_w × buf_h pixel buffer (RGB565, big-endian)
static void render_text_to_buf(uint8_t* buf, int buf_w, int buf_h,
                                const char* text, uint16_t fg, uint16_t bg) {
    uint8_t bg_hi = bg >> 8, bg_lo = bg & 0xFF;
    for (int i = 0; i < buf_w * buf_h * 2; i += 2) {
        buf[i] = bg_hi; buf[i + 1] = bg_lo;
    }

    int scale    = (buf_h >= FONT_H * 2) ? 2 : 1;
    int char_h   = FONT_H * scale;
    int char_w   = FONT_W * scale;
    int cpl      = buf_w / char_w;
    int max_rows = buf_h / char_h;
    if (max_rows > MAX_LINES) max_rows = MAX_LINES;

    char lines[MAX_LINES][21];
    int nlines = split_lines(text, cpl, lines, max_rows);
    if (nlines > max_rows) nlines = max_rows;

    int block_h = nlines * char_h;
    int y_start = (buf_h - block_h) / 2;

    for (int li = 0; li < nlines; li++) {
        int line_len = (int)strlen(lines[li]);
        int line_w   = line_len * char_w;
        int x_start  = (buf_w - line_w) / 2;
        int y        = y_start + li * char_h;
        for (int ci = 0; ci < line_len; ci++) {
            draw_char_scaled(buf, x_start + ci * char_w, y,
                             lines[li][ci], scale, fg, bg, buf_w, buf_h);
        }
    }
}

// ============================================================
// Public API
// ============================================================

esp_err_t text_render_to_display(uint8_t display_id, const char* text,
                                  uint16_t fg_color, uint16_t bg_color) {
    if (!text || !text[0]) return ESP_ERR_INVALID_ARG;

    size_t buf_size = DISPLAY_BUFFER_SIZE;  // 160*160*2 = 51200 bytes
    uint8_t* buf = heap_caps_malloc(buf_size, MALLOC_CAP_DMA | MALLOC_CAP_SPIRAM);
    if (!buf) {
        ESP_LOGE(TAG, "Failed to allocate text render buffer");
        return ESP_ERR_NO_MEM;
    }

    render_text_to_buf(buf, DISPLAY_WIDTH, DISPLAY_HEIGHT, text, fg_color, bg_color);
    esp_err_t ret = gc9a01_draw_image(display_id, buf, DISPLAY_WIDTH, DISPLAY_HEIGHT);

    free(buf);
    return ret;
}

esp_err_t text_render_to_region(uint8_t display_id, const char* text,
                                 uint16_t fg_color, uint16_t bg_color,
                                 uint16_t y_offset, uint16_t region_h) {
    if (region_h == 0) return ESP_OK;

    size_t buf_size = (size_t)DISPLAY_WIDTH * region_h * 2;
    uint8_t* buf = heap_caps_malloc(buf_size, MALLOC_CAP_DMA | MALLOC_CAP_SPIRAM);
    if (!buf) {
        ESP_LOGE(TAG, "Failed to allocate region text render buffer");
        return ESP_ERR_NO_MEM;
    }

    if (text && text[0]) {
        render_text_to_buf(buf, DISPLAY_WIDTH, region_h, text, fg_color, bg_color);
    } else {
        // No text — just fill with background color
        uint8_t bg_hi = bg_color >> 8, bg_lo = bg_color & 0xFF;
        for (size_t i = 0; i < buf_size; i += 2) {
            buf[i] = bg_hi; buf[i + 1] = bg_lo;
        }
    }

    // buf is exactly DISPLAY_WIDTH × region_h — draw it at the target y offset
    esp_err_t ret = gc9a01_draw_image_in_region(display_id, buf,
                                                 DISPLAY_WIDTH, region_h,
                                                 y_offset, region_h);
    free(buf);
    return ret;
}

void text_render_fill_region(uint8_t* frame_buf, int frame_w,
                              int region_y, int region_h,
                              const char* text, uint16_t fg, uint16_t bg) {
    if (!frame_buf || region_h <= 0 || frame_w <= 0) return;
    uint8_t* region_ptr = frame_buf + (size_t)frame_w * region_y * 2;
    render_text_to_buf(region_ptr, frame_w, region_h, text ? text : "", fg, bg);
}
