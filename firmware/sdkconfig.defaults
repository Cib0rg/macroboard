## firmware/sdkconfig.defaults
```kconfig
# ESP32-S3 Configuration
CONFIG_IDF_TARGET="esp32s3"

# Flash size
CONFIG_ESPTOOLPY_FLASHSIZE_16MB=y
CONFIG_ESPTOOLPY_FLASHFREQ_80M=y
CONFIG_ESPTOOLPY_FLASHMODE_QIO=y

# Partition table
CONFIG_PARTITION_TABLE_CUSTOM=y
CONFIG_PARTITION_TABLE_CUSTOM_FILENAME="partitions.csv"
CONFIG_PARTITION_TABLE_FILENAME="partitions.csv"

# PSRAM Configuration
CONFIG_SPIRAM=y
CONFIG_SPIRAM_MODE_OCT=y
CONFIG_SPIRAM_SPEED_80M=y
CONFIG_SPIRAM_USE_MALLOC=y
CONFIG_SPIRAM_MALLOC_ALWAYSINTERNAL=16384

# Console: use UART, not USB (USB is used for TinyUSB device)
CONFIG_ESP_CONSOLE_USB_SERIAL_JTAG=n
CONFIG_ESP_CONSOLE_UART_DEFAULT=y
CONFIG_ESP_CONSOLE_UART_NUM=0

# USB Configuration — Composite device: HID + Vendor
CONFIG_TINYUSB_HID_COUNT=1
CONFIG_TINYUSB_VENDOR_COUNT=1

# Custom VID/PID — must match USB_VID/USB_PID in config.h
CONFIG_TINYUSB_DESC_USE_ESPRESSIF_VID=n
CONFIG_TINYUSB_DESC_CUSTOM_VID=0x1209
CONFIG_TINYUSB_DESC_USE_DEFAULT_PID=n
CONFIG_TINYUSB_DESC_CUSTOM_PID=0x0001

# Custom Strings
CONFIG_TINYUSB_DESC_MANUFACTURER_STRING="Elgato"
CONFIG_TINYUSB_DESC_PRODUCT_STRING="Stream Deck"
CONFIG_TINYUSB_DESC_SERIAL_STRING="123456"

# FreeRTOS
CONFIG_FREERTOS_HZ=1000
CONFIG_FREERTOS_UNICORE=n
CONFIG_FREERTOS_USE_TRACE_FACILITY=y
CONFIG_FREERTOS_USE_STATS_FORMATTING_FUNCTIONS=y

# Logging
CONFIG_LOG_DEFAULT_LEVEL_INFO=y
CONFIG_LOG_MAXIMUM_LEVEL_VERBOSE=y

# Compiler optimization
CONFIG_COMPILER_OPTIMIZATION_PERF=y

# SPIFFS
CONFIG_SPIFFS_MAX_PARTITIONS=3

# JPEG Decoder
CONFIG_JPEG_DECODER_ENABLED=y
```
